## drivers/qti/Kconfig
```kconfig
source "drivers/qti/mhi/Kconfig"
source "drivers/qti/qrtr/Kconfig"
source "drivers/qti/rmnet_data/Kconfig"
source "drivers/qti/rmnet_usb/Kconfig"
source "drivers/qti/usb_bridge/Kconfig"
```
